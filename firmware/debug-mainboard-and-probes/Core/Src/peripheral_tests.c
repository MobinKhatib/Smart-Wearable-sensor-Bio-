/*******************************************************************************
 * @file    peripheral_tests.c
 * @author  Ilaria Crupi
 * @date    29-Aug-2025
 * @brief   Test functions for sensors and peripherals present on main board
 *  *
 * This file contains the implementation of test routines to verify the correct
 * communication and operation of the sensors and peripherals present
 * on the main board:
 *
 * - MAIN BOARD
 * - test_USB_TX(): verifies USB CDC transmission
 * - test_BLE(): verifies UART communication with BLE module
 * - test_IMU_IS(): reads the WHO_AM_I register of the LSM6DSO16IS IMU
 * - test_NAND(): verifies SPI communication with the NAND memory by reading its ID
 *
 * Each test function transmits a message via USB CDC with the test status
 * (PASSED/FAILED) and turns on/off the status LEDs for visual feedback.
 *
 ******************************************************************************/


#include "main.h"
#include <stdio.h>
#include <string.h>
#include "peripheral_tests.h"
#include "../../USB_Device/App/usb_device.h"
#include "bluetooth.h"
#include "imu_driver.h"
#include "SPI.h"
#include "SPI_NAND.h"
#include "SPI_DMA_NAND.h"
#include "led_driver.h"


extern uint8_t flag;
extern UART_HandleTypeDef huart3;

char ble_tx_buffer[TEXT_LENGTH];
uint8_t ble_rx_buffer[1];
char text_buffer[64];

// --- IMPLEMENTATION OF MAIN BOARD TEST FUNCTIONS ---
// --- MAIN BOARD ---

/**
 * @brief Basic test to verify USB CDC transmission.
 */
void test_USB_TX(void) {

    char text_buffer[64];
    snprintf(text_buffer, sizeof(text_buffer), "[TEST] Hello from USB! \r\n");

    if(flag)
    {
        CDC_Transmit_FS((uint8_t*)text_buffer, strlen(text_buffer));
        HAL_Delay(1000);
    }
}


/**
 * @brief Tests UART communication with the BLE module. 
 * The Bluetooth test in the current code acts as an "Echo Test". 
 * To test it, you need to open a BLE testing app on your smartphone (e.g., LightBlue or Serial Monitor), 
 * connect to the device, find the RX/TX characteristic, and send a text string: 
 * the board should respond by sending the exact same text back to you. 
 */
void test_BLE(UART_HandleTypeDef *huart) {
	// Send Data
	int buflen = snprintf(ble_tx_buffer,TEXT_LENGTH,"\r\nBLE Echo Test Started. Send data to receive it back.\r\n");
	BLE_SendData((uint8_t*) ble_tx_buffer, buflen);

	// Starts receiving 1 byte in interrupt mode.
	// When the byte arrives, HAL_UART_RxCpltCallback will be called.
	HAL_UART_Receive_IT(&huart3, ble_rx_buffer, 1);
}

void HAL_UART_RxCpltCallback(UART_HandleTypeDef *huart) {
    // Checks if the interrupt was generated by the BLE UART
    if (huart->Instance == USART3) {
        // 1. Immediately sends the character we just received
        BLE_SendData(ble_rx_buffer, 1);

        // 2. Reactivates reception in interrupt mode for the next character
        HAL_UART_Receive_IT(&huart3, ble_rx_buffer, 1);
    }
}


/**
 * @brief Tests SPI communication with the NAND memory
 */
void test_NAND(void)
{
	if(flag)
	    {
	        snprintf(text_buffer, sizeof(text_buffer), "[TEST] Reading Memory ID on main board...");
	        CDC_Transmit_FS((uint8_t*)text_buffer, strlen(text_buffer));
            HAL_Delay(1000);
	    }

	int NAND_ID = 0;

	NAND_ID = read_id();

	if(NAND_ID == SPI_NAND_RET_OK)
	{
		if(flag)
		{
			snprintf(text_buffer, sizeof(text_buffer), "PASSED! \r\n");
			CDC_Transmit_FS((uint8_t*)text_buffer, strlen(text_buffer));
		}

        LED_On(LED_GREEN);
        HAL_Delay(1000);
        LED_Off(LED_GREEN);
        HAL_Delay(1000);
	}
	else
	{
        if(flag)
        {
        	snprintf(text_buffer, sizeof(text_buffer), "FAILED :( \r\n");
			CDC_Transmit_FS((uint8_t*)text_buffer, strlen(text_buffer));
        }
        LED_On(LED_RED);
        HAL_Delay(1000);
        LED_Off(LED_RED);
        HAL_Delay(1000);
	}

}


/**
 * @brief Tests I2C communication with the IMU sensor on the main board (ISPU) by reading the WHO_AM_I register.
 */
void test_IMU_IS(I2C_HandleTypeDef *hi2c) {
    uint8_t who_am_i_value = 0;

    if(flag)
    {
        snprintf(text_buffer, sizeof(text_buffer), "[TEST] Communication with IMU ISPU on main board...");
        CDC_Transmit_FS((uint8_t*)text_buffer, strlen(text_buffer));
    }

    // Read the WHO_AM_I register and check if the returned value matches the expected one
    if (imu_read_register(IMU_WHO_AM_I_REG, &who_am_i_value, 1) && (who_am_i_value == IMU_WHO_AM_I_VALUE)) {
        if(flag)
        {
			snprintf(text_buffer, sizeof(text_buffer), "PASSED! (ID: 0x%02X)\r\n", who_am_i_value);
			CDC_Transmit_FS((uint8_t*)text_buffer, strlen(text_buffer));
        }
        LED_On(LED_GREEN);
        HAL_Delay(1000);
        LED_Off(LED_GREEN);
        HAL_Delay(1000);
    }else
    {
        if(flag)
        {
            snprintf(text_buffer, sizeof(text_buffer), "FAILED :( \r\n");
            CDC_Transmit_FS((uint8_t*)text_buffer, strlen(text_buffer));
        }
        LED_On(LED_RED);
        HAL_Delay(1000);
        LED_Off(LED_RED);
        HAL_Delay(1000);
    }
}